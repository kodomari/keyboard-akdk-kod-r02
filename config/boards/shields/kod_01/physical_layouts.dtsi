// physical_layouts.dtsi

/ {
    physical_layout0: physical_layout_0 {
        compatible = "zmk,physical-layout";
        key-positions = <
            // Row 0
            0 1 2 3 4 5 6 8 9 10 11 12 13 14
            // Row 1
            15 16 17 18 19 20 22 23 24 25 26 27 28 29
            // Row 2
            30 31 32 33 34 35 37 38 39 40 41 42 43 44
            // Row 3
            45 46 47 48 49 50 52 53 54 55 56 57 58 59
            // Row 4
            60 61 62 63 64 67 68 69 70 71 72 73 74
        >;
        zmk,studio-support;
    };
};
